## config/boards/shields/shrimp/Kconfig.shield
```kconfig
/*
 * Copyright (c) 2021 The ZMK Contributors
 *
 * SPDX-License-Identifier: MIT
 */

config SHIELD_SHRIMP_LEFT
	def_bool $(shields_list_contains,shrimp_left)

config SHIELD_SHRIMP_RIGHT
	def_bool $(shields_list_contains,shrimp_right)
```
